## Documentation/devicetree/bindings/clock/qcom,sm8350-camcc.yaml
```yaml
# SPDX-License-Identifier: (GPL-2.0-only OR BSD-2-Clause)
%YAML 1.2
---
$id: http://devicetree.org/schemas/clock/qcom,sm8350-camcc.yaml#
$schema: http://devicetree.org/meta-schemas/core.yaml#

title: Qualcomm SM8350 Camera Clock & Reset Controller

maintainers:
  - Alexandru Andries <alex.andries.aa@gmail.com>

description: |
  Qualcomm camera clock control module provides the clocks, resets and power
  domains on SM8350.

  See also:
    include/dt-bindings/clock/qcom,sm8350-camcc.h

properties:
  compatible:
    const: qcom,sm8350-camcc

  clocks:
    items:
      - description: Board XO source
      - description: Board active XO source
      - description: Board sleep clock

  power-domains:
    description:
      A phandle and PM domain specifier for the MMCX power domain.
    maxItems: 1

  required-opps:
    description:
      A phandle to an OPP node describing required MMCX performance point.
    maxItems: 1

required:
  - compatible
  - clocks
  - power-domains
  - required-opps

allOf:
  - $ref: qcom,gcc.yaml#

unevaluatedProperties: false

examples:
  - |
    #include <dt-bindings/clock/qcom,rpmh.h>
    #include <dt-bindings/power/qcom,rpmhpd.h>

    clock-controller@ad00000 {
      compatible = "qcom,sm8350-camcc";
      reg = <0x0ad00000 0x10000>;
      clocks = <&rpmhcc RPMH_CXO_CLK>,
               <&rpmhcc RPMH_CXO_CLK_A>,
               <&sleep_clk>;
      power-domains = <&rpmhpd RPMHPD_MMCX>;
      required-opps = <&rpmhpd_opp_low_svs>;
      #clock-cells = <1>;
      #reset-cells = <1>;
      #power-domain-cells = <1>;
    };
...
```

## Documentation/devicetree/bindings/display/panel/xiaomi,odin-csot-nt37701.yaml
```yaml
# SPDX-License-Identifier: (GPL-2.0-only OR BSD-2-Clause)
%YAML 1.2
---
$id: http://devicetree.org/schemas/display/panel/xiaomi,odin-csot-nt37701.yaml#
$schema: http://devicetree.org/meta-schemas/core.yaml#

title: Xiaomi MIX 4 CSOT K8 42-02-0a (Novatek NT37701) AMOLED DSI Panel

maintainers:
  - Neil Armstrong <neil.armstrong@linaro.org>

description:
  1080x2400 120Hz under-display-camera (CUP) AMOLED command-mode DSC 1.1 panel
  manufactured by CSOT with a Novatek NT37701-family DDIC, used in the Xiaomi
  MIX 4 (odin) smartphone.

allOf:
  - $ref: panel-common.yaml#

properties:
  compatible:
    const: xiaomi,odin-csot-nt37701

  reg:
    maxItems: 1
    description: DSI virtual channel

  avdd-supply:
    description: Analog 3.0V power supply

  vddd-supply:
    description: Digital core power supply

  vddio-supply:
    description: Digital I/O 1.8V power supply

  reset-gpios: true
  port: true

required:
  - compatible
  - reg
  - avdd-supply
  - vddd-supply
  - vddio-supply
  - reset-gpios
  - port

additionalProperties: false

examples:
  - |
    #include <dt-bindings/gpio/gpio.h>

    dsi {
        #address-cells = <1>;
        #size-cells = <0>;

        panel@0 {
            compatible = "xiaomi,odin-csot-nt37701";
            reg = <0>;
            avdd-supply = <&pm8350c_l13>;
            vddd-supply = <&disp_vddd_vreg>;
            vddio-supply = <&disp_vddi_vreg>;
            reset-gpios = <&tlmm 24 GPIO_ACTIVE_LOW>;

            port {
                endpoint {
                    remote-endpoint = <&mdss_dsi0_out>;
                };
            };
        };
    };
...
```

## Documentation/devicetree/bindings/input/touchscreen/st,fts-spi.yaml
```yaml
# SPDX-License-Identifier: (GPL-2.0-only OR BSD-2-Clause)
%YAML 1.2
---
$id: http://devicetree.org/schemas/input/touchscreen/st,fts-spi.yaml#
$schema: http://devicetree.org/meta-schemas/core.yaml#

title: STMicroelectronics FingerTip S (FTS5) SPI Touchscreen Controller

maintainers:
  - Andi Shyti <andi.shyti@kernel.org>

allOf:
  - $ref: touchscreen.yaml#
  - $ref: /schemas/spi/spi-peripheral-props.yaml#

properties:
  compatible:
    const: st,fts-spi

  reg:
    maxItems: 1

  interrupts:
    maxItems: 1

  reset-gpios:
    maxItems: 1

  avdd-supply:
    description: Analog 3.3V power supply

  vdd-supply:
    description: Digital I/O 1.8V power supply

  st,super-resolution:
    type: boolean
    description:
      Controller firmware reports 16-bit super-resolution X/Y coordinates in
      events rather than packed 12-bit coordinates.

required:
  - compatible
  - reg
  - interrupts
  - avdd-supply
  - vdd-supply

unevaluatedProperties: false

examples:
  - |
    #include <dt-bindings/gpio/gpio.h>
    #include <dt-bindings/interrupt-controller/irq.h>
    spi {
        #address-cells = <1>;
        #size-cells = <0>;

        touchscreen@0 {
            compatible = "st,fts-spi";
            reg = <0>;
            spi-max-frequency = <7000000>;
            interrupt-parent = <&tlmm>;
            interrupts = <23 IRQ_TYPE_LEVEL_LOW>;
            reset-gpios = <&tlmm 22 GPIO_ACTIVE_LOW>;
            avdd-supply = <&touch_avdd_vreg>;
            vdd-supply = <&pm8350c_l2>;
            touchscreen-size-x = <10800>;
            touchscreen-size-y = <24000>;
            st,super-resolution;
        };
    };
```

## Documentation/devicetree/bindings/media/i2c/dongwoon,dw9825.yaml
```yaml
# SPDX-License-Identifier: (GPL-2.0-only OR BSD-2-Clause)
%YAML 1.2
---
$id: http://devicetree.org/schemas/media/i2c/dongwoon,dw9825.yaml#
$schema: http://devicetree.org/meta-schemas/core.yaml#

title: Dongwoon Anatech DW9825A voice coil lens actuator

maintainers:
  - Linux Media Mailing List <linux-media@vger.kernel.org>

description:
  DW9825A is a closed-loop Hall-effect voice coil motor (VCM) camera lens
  actuator controlled over I2C.

properties:
  compatible:
    enum:
      - dongwoon,dw9825a

  reg:
    maxItems: 1

  vdd-supply:
    description: VDD supply

  vio-supply:
    description: I/O pull-up supply

required:
  - compatible
  - reg
  - vdd-supply
  - vio-supply

additionalProperties: false

examples:
  - |
    i2c {
        #address-cells = <1>;
        #size-cells = <0>;

        dw9825a: lens@c {
            compatible = "dongwoon,dw9825a";
            reg = <0x0c>;

            vdd-supply = <&pm8008i_l7>;
            vio-supply = <&pm8008i_l6>;
        };
    };

...
```

## Documentation/devicetree/bindings/media/i2c/hynix,hi847.yaml
```yaml
# SPDX-License-Identifier: (GPL-2.0-only OR BSD-2-Clause)
%YAML 1.2
---
$id: http://devicetree.org/schemas/media/i2c/hynix,hi847.yaml#
$schema: http://devicetree.org/meta-schemas/core.yaml#

title: SK Hynix Hi-847 1/4" 8M Pixel MIPI CSI-2 sensor

maintainers:
  - Alexandru Andrieș <alex.andries.aa@gmail.com>

description: |-
  The Hi-847 is a raw image sensor with a MIPI CSI-2 image data
  interface and CCI (I2C compatible) control bus. The output format
  is raw Bayer.

allOf:
  - $ref: /schemas/media/video-interface-devices.yaml#

properties:
  compatible:
    const: hynix,hi847

  reg:
    maxItems: 1

  clocks:
    items:
      - description: Reference to the mclk clock (19.2 MHz).

  reset-gpios:
    description: Reference to the GPIO connected to the RESETB pin. Active low.
    maxItems: 1

  vddio-supply:
    description: Definition of the regulator used for the VDDIO power supply.

  vdda-supply:
    description: Definition of the regulator used for the VDDA power supply.

  vddd-supply:
    description: Definition of the regulator used for the VDDD power supply.

  port:
    $ref: /schemas/graph.yaml#/$defs/port-base
    unevaluatedProperties: false

    properties:
      endpoint:
        $ref: /schemas/media/video-interfaces.yaml#
        unevaluatedProperties: false

        properties:
          data-lanes:
            oneOf:
              - items:
                  - const: 1
                  - const: 2
              - items:
                  - const: 1
                  - const: 2
                  - const: 3
                  - const: 4

          link-frequencies: true

        required:
          - data-lanes
          - link-frequencies

required:
  - compatible
  - reg
  - clocks
  - vddio-supply
  - vdda-supply
  - vddd-supply
  - port

unevaluatedProperties: false

examples:
  - |
    #include <dt-bindings/gpio/gpio.h>
    #include <dt-bindings/media/video-interface-devices.h>

    i2c {
        #address-cells = <1>;
        #size-cells = <0>;

        camera@20 {
            compatible = "hynix,hi847";
            reg = <0x20>;
            clocks = <&clk 0>;
            vddio-supply = <&reg_camera_vddio>;
            vdda-supply = <&reg_camera_vdda>;
            vddd-supply = <&reg_camera_vddd>;
            reset-gpios = <&gpio1 25 GPIO_ACTIVE_LOW>;
            orientation = <MEDIA_ORIENTATION_BACK>;
            rotation = <90>;

            port {
                camera_out: endpoint {
                    remote-endpoint = <&csi_ep>;
                    link-frequencies = /bits/ 64
                        <400000000 200000000>;
                    data-lanes = <1 2 3 4>;
                };
            };
        };
    };

...
```

## Documentation/devicetree/bindings/media/i2c/ovti,ov13b10.yaml
```yaml
# SPDX-License-Identifier: (GPL-2.0-only OR BSD-2-Clause)
%YAML 1.2
---
$id: http://devicetree.org/schemas/media/i2c/ovti,ov13b10.yaml#
$schema: http://devicetree.org/meta-schemas/core.yaml#

title: OmniVision OV13B10 1/3-inch 13MP CMOS image sensor

maintainers:
  - Alexandru Andries <alex.andries.aa@gmail.com>

description:
  The OmniVision OV13B10 is a 1/3-inch 13-megapixel CMOS image sensor with an
  active array size of 4208 x 3120. It is programmable through an I2C
  interface and outputs 10-bit raw Bayer image data over 2 or 4 MIPI CSI-2
  D-PHY lanes.

allOf:
  - $ref: /schemas/media/video-interface-devices.yaml#

properties:
  compatible:
    const: ovti,ov13b10

  reg:
    maxItems: 1

  clocks:
    description: External clock input (19.2 MHz)
    maxItems: 1

  reset-gpios:
    description: Active low XSHUTDN pin
    maxItems: 1

  dovdd-supply:
    description: Digital I/O power supply (1.8V)

  avdd-supply:
    description: Analog power supply (2.8V)

  dvdd-supply:
    description: Digital core power supply (1.2V)

  port:
    $ref: /schemas/graph.yaml#/$defs/port-base
    additionalProperties: false

    properties:
      endpoint:
        $ref: /schemas/media/video-interfaces.yaml#
        unevaluatedProperties: false

        properties:
          data-lanes:
            oneOf:
              - items:
                  - const: 1
                  - const: 2
              - items:
                  - const: 1
                  - const: 2
                  - const: 3
                  - const: 4

        required:
          - data-lanes
          - link-frequencies

    required:
      - endpoint

required:
  - compatible
  - reg
  - clocks
  - port

unevaluatedProperties: false

examples:
  - |
    #include <dt-bindings/gpio/gpio.h>
    #include <dt-bindings/media/video-interface-devices.h>

    i2c {
        #address-cells = <1>;
        #size-cells = <0>;

        camera@10 {
            compatible = "ovti,ov13b10";
            reg = <0x10>;

            clocks = <&camcc_mclk2>;
            assigned-clocks = <&camcc_mclk2>;
            assigned-clock-rates = <19200000>;

            reset-gpios = <&tlmm 117 GPIO_ACTIVE_LOW>;

            dovdd-supply = <&pm8008i_l6>;
            avdd-supply = <&vreg_cam_ultra_vana>;
            dvdd-supply = <&vreg_cam_ultra_tele_dvdd>;

            orientation = <MEDIA_ORIENTATION_BACK>;
            rotation = <90>;

            port {
                endpoint {
                    data-lanes = <1 2 3 4>;
                    link-frequencies = /bits/ 64 <560000000>;
                    remote-endpoint = <&csiphy3_ep>;
                };
            };
        };
    };
...
```

## Documentation/devicetree/bindings/media/i2c/samsung,s5k3t2.yaml
```yaml
# SPDX-License-Identifier: (GPL-2.0-only OR BSD-2-Clause)
%YAML 1.2
---
$id: http://devicetree.org/schemas/media/i2c/samsung,s5k3t2.yaml#
$schema: http://devicetree.org/meta-schemas/core.yaml#

title: Samsung S5K3T2 Image Sensor

description:
  Samsung S5K3T2 (ISOCELL Slim 3T2) is a 20MP (5184x3880) CMOS image sensor.
  The sensor is controlled over an I2C interface and outputs 10-bit RAW
  Bayer image data over a 4-lane MIPI CSI-2 D-PHY interface.

maintainers:
  - Alexandru Andrieș <alex.andries.aa@gmail.com>

allOf:
  - $ref: /schemas/media/video-interface-devices.yaml#

properties:
  compatible:
    const: samsung,s5k3t2

  reg:
    maxItems: 1

  clocks:
    description: External master clock (MCLK) supplied to the sensor.
    maxItems: 1

  reset-gpios:
    description: Active low GPIO connected to the XSHUTDOWN/RESET pin.
    maxItems: 1

  vdda-supply:
    description: Analogue voltage supply, 2.8 volts.

  vddd-supply:
    description: Digital core voltage supply, 1.05 volts.

  vddio-supply:
    description: Digital I/O voltage supply, 1.8 volts.

  port:
    $ref: /schemas/graph.yaml#/$defs/port-base
    additionalProperties: false

    properties:
      endpoint:
        $ref: /schemas/media/video-interfaces.yaml#
        unevaluatedProperties: false

        properties:
          data-lanes:
            items:
              - const: 1
              - const: 2
              - const: 3
              - const: 4

        required:
          - link-frequencies

required:
  - compatible
  - reg
  - clocks
  - port

unevaluatedProperties: false

examples:
  - |
      #include <dt-bindings/gpio/gpio.h>

      i2c {
          #address-cells = <1>;
          #size-cells = <0>;

          camera@10 {
              compatible = "samsung,s5k3t2";
              reg = <0x10>;
              clocks = <&camera_mclk 1>;
              assigned-clocks = <&camera_mclk 1>;
              assigned-clock-rates = <19200000>;
              reset-gpios = <&tlmm 17 GPIO_ACTIVE_LOW>;
              vdda-supply = <&vreg_2p8>;
              vddd-supply = <&vreg_1p05>;
              vddio-supply = <&vreg_1p8>;

              port {
                  endpoint {
                      data-lanes = <1 2 3 4>;
                      link-frequencies = /bits/ 64 <310400000>;
                      remote-endpoint = <&mipi_csi2_ep>;
                  };
              };
          };
      };
...
```
